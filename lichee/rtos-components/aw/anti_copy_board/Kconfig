## lichee/rtos-components/aw/anti_copy_board/Kconfig
```kconfig
config COMPONENTS_AW_ANTI_COPY_BOARD
    bool "anti-copy-board"
    depends on (COMPONENT_CLI_COMMANDS && DRIVERS_EFUSE && DRIVERS_CE)
    default n
    help
        sunxi anti copy board.

        If unsure, say N.
```

## lichee/rtos-components/aw/format/Kconfig
```kconfig
config COMPONENTS_FORMAT
	bool "Format Support"
	default n
	help
		support component aw format.
```

## lichee/rtos-components/aw/network/wlan_csfc/Kconfig
```kconfig
choice
    prompt "get wifi mac address"
    default COMPONENTS_WLAN_MAC_DEFAULT

config COMPONENTS_WLAN_MAC_DEFAULT
    bool "set wifi mac by default value"
config COMPONENTS_WLAN_MAC_RANDOM
    bool "set wifi mac by random value"
config COMPONENTS_WLAN_MAC_PARAM
    bool "set wifi mac by param"
config COMPONENTS_WLAN_MAC_FILE
    bool "set wifi mac by file"
config COMPONENTS_WLAN_MAC_EFUSE
    bool "set wifi mac by efuse"
config COMPONENTS_WLAN_MAC_CHIPID
    bool "set wifi mac by chipid"
endchoice
```

## lichee/rtos-components/aw/pm/Kconfig
```kconfig
menuconfig COMPONENTS_PM
    bool "PowerManager Support"
    default n
    help
      Support standby and hibernation mode.

if COMPONENTS_PM
choice COMPONENTS_PM_CORE
    prompt "Select core"
    default COMPONENTS_PM_CORE_M33   if ARCH_ARM_ARMV8M
    default COMPONENTS_PM_CORE_RISCV if ARCH_RISCV_RV64
    default COMPONENTS_PM_CORE_DSP   if ARCH_DSP
    help
      This option determines which core the PM run on.

    config COMPONENTS_PM_CORE_M33
        bool "M33"
        help
          the code for m33

    config COMPONENTS_PM_CORE_DSP
        bool "DSP"
        help
          the code for dsp

    config COMPONENTS_PM_CORE_RISCV
        bool "RISCV"
        help
          the code for riscv
endchoice

comment "Special Config"
config ARCH_PM_FIRMWARE_BASE
    hex "PM Firmware's space base"
    default 0x04000000
    depends on COMPONENTS_PM_CORE_M33
    help
      The space must be placed on SRAM.
      This parameter takes effect only after
      COMPONENTS_PM_CORE_M33 is enabled

config ARCH_PM_FIRMWARE_SIZE
    hex "PM Firmware's space size"
    default 0x10000
    depends on COMPONENTS_PM_CORE_M33
    help
      The recommended value is not less than 64K.

config PM_SIMULATED_RUNNING
    bool "Simulated on FPGA"
    default n
    help
      Simulates a running environment on the FPGA

config PM_SUBSYS_RISCV_SUPPORT
    bool "support riscv subsys"
    default y
    depends on COMPONENTS_PM_CORE_M33
    help
      Enable riscv subsys support

config PM_SUBSYS_DSP_SUPPORT
    bool "support dsp subsys"
    default n
    depends on COMPONENTS_PM_CORE_M33
    help
      Enable dsp subsys support

config COMPONENTS_PM_TEST_TOOLS
    bool "PM test tools"
    default n
    depends on COMPONENTS_PM
    help
      Enable pm test tools, including pm stress, recording sign and etc.

endif
```

## lichee/rtos-components/aw/tinatest/testcase/audio/Kconfig
```kconfig
menu "Audio Testcase"
	depends on COMPONENTS_AW_ALSA_LIB || COMPONENTS_AW_AUDIO_SYSTEM
	depends on COMPONENTS_AW_ALSA_UTILS || COMPONENTS_AW_AUDIO_SYSTEM_UTILS

config TESTCASE_AUDIO_MIC_CAPTURE
	bool "Audio MIC capture testcase."
	default n

config TESTCASE_AUDIO_SPEAKER_PLAYBACK
	bool "Audio speaker playback testcase."
	default n

config TESTCASE_AUDIO_PLAYBACK_AND_CAPTURE
	bool "Audio playback and then capture testcase."
	default n

config TESTCASE_AUDIO_PLAYBACK_OPEN_CLOSE
	bool "Audio open close playback soundcard testcase."
	default n

config TESTCASE_AUDIO_PLAYBACK_LOOP
	bool "Audio playback loop testcase."
	default n

if TESTCASE_AUDIO_PLAYBACK_LOOP
config PLAYBACK_LOOP_COUNTS
	default 10
	string "playback loop test times"
	help
		This means how many times to test playback loop
endif

config TESTCASE_AUDIO_CAPTURE_LOOP
	bool "Audio capture loop testcase."
	default n

if TESTCASE_AUDIO_CAPTURE_LOOP
config CAPTURE_LOOP_COUNTS
	default 10
	string "capture loop test times"
	help
		This means how many times to test capture loop

config CAPTURE_LOOP_SAVE_PATH
	default "/data/capture_loop.wav"
	string "capture loop test path"
	help
		This mean which directory to save capture loop test.

endif

endmenu
```

## lichee/rtos-components/aw/tinatest/testcase/camera/Kconfig
```kconfig
config TESTCASE_CAMERA
	bool "Camera Testcase."
	select DRIVERS_CSI
	select HAL_TEST_CSI
	default n
```

## lichee/rtos-components/aw/tinatest/testcase/cpu/Kconfig
```kconfig
menu "CPU Testcase"

config TESTCASE_CPU_CALC
	bool "CPU_CALC Testcase."
	select COMPONENT_DHRYSTONE
	select COMPONENT_COREMARK
	default n

if TESTCASE_CPU_CALC
config LOOP_TIMES
       default "10000"
       string "loop times"
       help
               This means how many cpu_calc test times need to be tested.
               Please input the reboot times.
endif

config TESTCASE_CPU_FREQ
	bool "CPU_FREQ Testcase."
	select COMPONENTS_PM
	default n

if TESTCASE_CPU_FREQ
config CPU_FREQ_LOOP_TIMES
       default "10000"
       string "loop times"
       help
               This means how many cpu_freq test times need to be tested.
               Please input the reboot times.

endif

config TESTCASE_CPU_THERMAL
	bool "CPU_THERMAL Testcase."
	select DRIVERS_EFUSE
	select DRIVERS_GPADC
	default n

if TESTCASE_CPU_THERMAL
config THERMAL_LOOP_TIMES
       default "10000"
       string "loop times"
       help
               This means how many thermal test times need to be tested.
               Please input the reboot times.

endif

endmenu
```

## lichee/rtos-components/aw/tinatest/testcase/display/Kconfig
```kconfig
menu "Display Testcase"

config TESTCASE_LVGL
	bool "LVGL Testcase."
	select COMPONENTS_LVGL8
	select LVGL8_EXAMPLES
	default n

config TESTCASE_DISPLAYIF
	bool "DISPLAYIF Testcase."
	depends on DISP2_SUNXI
	default n

endmenu
```

## lichee/rtos-components/aw/tinatest/testcase/standby/Kconfig
```kconfig
config TESTCASE_STANDBY
	bool "STANDBY Testcase."
	select COMPONENTS_PM
	default n

if TESTCASE_STANDBY
config STANDBY_LOOP_TIMES
       default "10000"
       string "loop times"
       help
               This means how many standby test times need to be tested.
               Please input the reboot times.
endif
```

## lichee/rtos-components/aw/usb/gadget/mtpd/Kconfig
```kconfig
config COMPONENTS_USB_GADGET_MTPD
    bool "MtpDaemon service"
    depends on DRIVERS_USB_GADGET_MTP
    depends on KERNEL_FREERTOS
    default n
    help
	mtp daemon service
```

## lichee/rtos-hal/hal/source/nand_flash/Kconfig
```kconfig
menu "Nand Flash Devices"

config DRIVERS_NAND_FLASH
    bool "enable nand flash driver"
        default n
    help
        This option enables the NAND flash driver.

config NAND_FLASH_DEBUG
    bool "enable nand flash debug log"
    depends on DRIVERS_NAND_FLASH
        default n
    help
        Enable this option to enable debug logging for the NAND flash driver.

config NAND_FLASH_NFTL
    bool "enable nand nftl"
    depends on DRIVERS_NAND_FLASH
        default n
    help
        Enable this option to support the NAND flash NFTL (NAND Flash Translation Layer) feature.
        PS:To enable this option, you need to have the nftl driver source code
        nftl driver directory is: nand_flash/lib

endmenu
```

## lichee/rtos/arch/arm/armv8m/sun20iw2p1/Kconfig
```kconfig
if ARCH_SUN20IW2P1

config POWER_FALL_PROTECTION
	bool "power fail protection"
	default n
	help
		When vbat drops to 2.7V, SoC will reset to prevent the system working
		in the wrong voltage.

config USE_EXTERNAL_LOW_FREQ_CRYSTAL_CLK
	bool "Use the external low frequency crystal clock"
	default n
	help
		Use the external low frequency crystal clock. After enable this config,
		the clock source of sys_32k, sysrtc_32k and ble_32k will be
		the external low frequency crystal.

config WAIT_RTC_COUNTER_WHEN_SWITCH_RTC_CLK_SRC
	bool "Wait RTC counter when switch RTC module clock source"
	default n
	help
		Wait the value of RTC second counter to increase 1 when switch RTC module
		clock source to a clock whose frequency is lower than previous clock. If we
		don't immediately switch clock source after the value of RTC second counter
		increase 1, the RTC time will jump and automatically recover after 31s.
		This configuration is used to fix RTC time jump issue and will add about
		maximal 1s elapsed time. If you need to use RTC, you should enable it.
endif
```

## lichee/rtos/components/aw/camera_preview/Kconfig
```kconfig
config COMPONENTS_CAMERA_PREVIEW
    bool "Camera Preview to LCD Support"
    default n
    help
        camera preview to lcd support.
```

## lichee/rtos/components/aw/ostest/kernel_test/Kconfig
```kconfig
menuconfig COMPONENTS_OSTEST_KERNEL
	bool "Kernel Testcase"

if COMPONENTS_OSTEST_KERNEL

config COMPONENTS_OSTEST_SCHEDULE
    bool "Schedule Testcase"
    default n

endif
```

## lichee/rtos/components/aw/wireless_video/Kconfig
```kconfig
menu "wireless_video"

		config COMPONENTS_WIRELESS_VIDEO
			bool "wlan video test demo"
			default n

endmenu
```

## lichee/rtos/components/thirdparty/xvid/Kconfig
```kconfig
menuconfig COMPONENT_XVID_DECRAW
    bool "XVID_DECRAW"
    default n
    help
        Enable xvid decoder demo which can decode xvid raw stream
```

## lichee/rtos/drivers/drv/bluetooth/driver/controller/Kconfig
```kconfig
choice
	prompt "Bluetooth Driver Controller"
	default XRADIO_BT_CONTROLLER

config XRADIO_BT_CONTROLLER
	bool "Xradio BT Controller"
	help
	  If this option is enabled, Xradio BT Controller is used.

endchoice

if XRADIO_BT_CONTROLLER
menu "xradio bt controller"
	source drivers/drv/bluetooth/driver/controller/xradio/Kconfig

config XRADIO_BT_CONTROLLER_CMD
	bool "xradio bt controller cmd"
	default n
	help
	  If this option is enabled, BT Controller cmd is enabled.

endmenu

endif
```

## lichee/rtos/projects/Kconfig
```kconfig
choice
    prompt "Configure Application"
    default PROJECT_R128S2_DEVKIT_M33

config PROJECT_R128S2_DEVKIT_M33
    bool "r128s2 devkit m33 system"
	select PROJECT_R128S2
    ---help---
        r128s2 devkit m33 system

config PROJECT_R128S2_DEVKIT_C906
    bool "r128s2 devkit c906 system"
	select PROJECT_R128S2
    ---help---
        r128s2 devkit c906 system

config PROJECT_R128S2_DEVKIT_RGB_M33
    bool "r128s2 devkit rgb m33 system"
	select PROJECT_R128S2
    ---help---
        r128s2 devkit rgb m33 system

config PROJECT_R128S2_DEVKIT_RGB_C906
    bool "r128s2 devkit rgb c906 system"
	select PROJECT_R128S2
    ---help---
        r128s2 devkit rgb c906 system

config PROJECT_R128S2_EVT_M33
    bool "r128s2 evt m33 system"
	select PROJECT_R128S2
    ---help---
        r128s2 evt m33 system

config PROJECT_R128S2_EVT_C906
    bool "r128s2 evt c906 system"
	select PROJECT_R128S2
    ---help---
        r128s2 evt c906 system

endchoice

config PROJECT_R128S2
    bool

config PLATFORM_FPGA
    bool "Run on fpga"
    default n

config PROJECT_TESTCASE
    bool "Project Testcase"
    default n
```
